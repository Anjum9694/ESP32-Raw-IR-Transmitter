#include <Wire.h>
#include <RTClib.h>
#include <pgmspace.h>

// DS3231 Connections (I2C)
#define DS3231_SDA 21
#define DS3231_SCL 22
RTC_DS3231 rtc;

// IR Transmitter Setup
const int IR_LED = 4;        // GPIO4 for IR LED
const int PWM_CHANNEL = 0;   // LEDC channel
const int PWM_FREQ = 38000;  // 38kHz
const int PWM_RES = 8;       // 8-bit resolution
const int DUTY_CYCLE = 85;   // 33% duty cycle

// Temperature Command Structure
struct TemperatureCommand {
  int temp;               // Temperature value (e.g., 24, 26)
  const uint16_t* irData; // Pointer to IR raw data
  int irLength;           // Length of IR data
};

// Schedule Structure
struct Schedule {
  uint8_t hour;
  uint8_t minute;
  int temp;               // Target temperature
};

// ================== USER CONFIGURATION ==================
// Add your IR raw data for each temperature here (PROGMEM)

//OFF AIRCON
const uint16_t IR_0[] PROGMEM = {
  4390, 4398, 579, 1570, 581, 494, 581, 1572, 579, 1570, 581, 495, 580, 494,
  581, 1570, 581, 494, 581, 494, 581, 1571, 580, 494, 581, 494, 581, 1571,
  580, 1570, 581, 495, 580, 1569, 582, 495, 580, 1571, 580, 1570, 581, 1571,
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  581, 1570, 581
};

//28 ECO ION
const uint16_t IR_1[] PROGMEM = {
  4416, 4371, 556, 1594, 557, 517, 558, 1595, 556, 1594, 557, 517,
  558, 517, 558, 1594, 557, 517, 558, 518, 557, 1595, 556, 517,
  558, 519, 556, 1595, 556, 1594, 557, 517, 558, 1594, 557, 1594,
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  557, 1594, 557, 1593, 558, 519, 556, 1595, 556, 1596, 555
};

//LED OFF
const uint16_t IR_2[] PROGMEM = {
  4392, 4398, 529, 1620, 531, 546, 529, 1622, 529, 1622, 529, 1620,
  531, 544, 531, 545, 530, 1622, 529, 546, 529, 1620, 531, 544,
  531, 544, 531, 544, 531, 1619, 532, 1622, 529, 546, 529, 1622,
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  555, 1596, 555, 1595, 556, 519, 556
};

//DRY 28 ION
const uint16_t IR_3[] PROGMEM = {
  4417, 4370, 557, 1594, 557, 517, 558, 1593, 558, 1594, 557, 1594,
  557, 519, 556, 517, 558, 1593, 558, 519, 556, 1595, 556, 518, 557, 519,
  556, 518, 557, 1594, 557, 1594, 557, 517, 558, 1595, 556, 1594, 557, 1593,
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  558, 1595, 556, 517, 558
};


//28 ion
const uint16_t IR_4[] PROGMEM = {
  4417, 4371, 556, 1595, 556, 519, 556, 1595, 556, 1596, 555, 519,
  556, 519, 556, 1594, 557, 519, 556, 519, 556, 1594, 557, 518,
  557, 519, 556, 1595, 556, 1595, 556, 519, 556, 1596, 555, 1594,
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  556, 1596, 555, 1595, 556, 519, 556, 1596, 555, 1595, 556
};

//28 sleep
const uint16_t IR_5[] PROGMEM = {
  4417, 4371, 556, 1595, 556, 520, 555, 1596, 555, 1596, 555, 519,
  556, 520, 555, 1595, 556, 519, 556, 520, 555, 1595, 556, 521,
  554, 519, 556, 1595, 556, 1596, 555, 520, 555, 1595, 555, 1596,
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  556, 1597, 554, 1595, 555, 521, 554, 1597, 554, 1596, 554
};

//CLEAN
const uint16_t IR_6[] PROGMEM = {
  4417, 4370, 557, 1595, 556, 519, 556, 1595, 556, 1594, 582, 1571,
  555, 518, 557, 519, 556, 1594, 581, 496, 555, 1593, 558, 518,
  557, 519, 556, 518, 557, 1594, 557, 1593, 583, 494, 581, 1572,
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  555, 520, 555, 520, 555, 519, 556
};


// Define temperature commands (add new entries here)
TemperatureCommand tempCommands[] = {
  {0, IR_0, sizeof(IR_0) / sizeof(IR_0[0])}, //0 OFF
  {1, IR_1, sizeof(IR_1) / sizeof(IR_1[0])}, //1 28 ECO ION
  {2, IR_2, sizeof(IR_2) / sizeof(IR_2[0])}, // 2 LED OFF
  {3, IR_3, sizeof(IR_3) / sizeof(IR_3[0])}, // 3 DRY 28 ION
  {4, IR_4, sizeof(IR_4) / sizeof(IR_4[0])}, // 4 28 ION
  {5, IR_5, sizeof(IR_5) / sizeof(IR_5[0])},  // 5 28 SLEEP
  {6, IR_6, sizeof(IR_6) / sizeof(IR_6[0])}  // 6 CLEAN
};

// Add descriptions for each temperature command (same order as tempCommands)
const char* tempDescriptions[] = {
  "OFF",
  "28 ECO ION",
  "LED OFF",
  "DRY 28 ION",
  "28 ION",
  "28 SLEEP",
  "CLEAN"
};

// Define your schedules (24-hour format)
Schedule schedules[] = {
  {7, 20, 0},  // 7:20 AM → OFF
  {15, 45, 3}, // 3:45 PM → 28°C ION DRY
  {16, 15, 0},   // 4:15 PM → OFF
  {21, 30, 2},   // 9:30 PM → LEDOFF
  {1, 30, 6}   // 1:30 AM → CLEAN
};
// =============== END OF USER CONFIGURATION ==============

void setupPWM() {
  ledcSetup(PWM_CHANNEL, PWM_FREQ, PWM_RES);
  ledcAttachPin(IR_LED, PWM_CHANNEL);
  ledcWrite(PWM_CHANNEL, 0);
}

void sendIRCommand(const TemperatureCommand &cmd) {
  for (int i = 0; i < cmd.irLength; i++) {
    unsigned long duration = pgm_read_word_near(&cmd.irData[i]);
    ledcWrite(PWM_CHANNEL, (i % 2 == 0) ? DUTY_CYCLE : 0);
    delayMicroseconds(duration);
  }
  ledcWrite(PWM_CHANNEL, 0);
}

void checkSchedules() {
  static DateTime lastCheck;
  DateTime now = rtc.now();

  if (now.minute() == lastCheck.minute()) return;

  for (Schedule s : schedules) {
    if (now.hour() == s.hour && now.minute() == s.minute) {
      Serial.printf("Time: %02d:%02d - Setting %d°C\n", s.hour, s.minute, s.temp);

      // Find matching temperature command
      for (TemperatureCommand tc : tempCommands) {
        if (tc.temp == s.temp) {
          sendIRCommand(tc);
          break;
        }
      }
    }
  }
  lastCheck = now;
}

void serialTimeSetup() {
  while (Serial.available()) {
    String input = Serial.readStringUntil('\n');
    input.trim();

    if (input.startsWith("SET ")) {
      int h, m, temp;
      if (sscanf(input.c_str(), "SET %d:%d %d", &h, &m, &temp) == 3) {
        // Add to schedules (temporary, not saved to flash)
        Schedule newSchedule = {(uint8_t)h, (uint8_t)m, temp};
        // Add your code here to store in EEPROM if needed
        Serial.printf("Added schedule: %02d:%02d → %d°C\n", h, m, temp);
      }
    }
    else if (input == "TIME") {
      DateTime now = rtc.now();
      Serial.printf("Current Time: %02d:%02d:%02d\n",
                    now.hour(), now.minute(), now.second());
    }
    else if (input.startsWith("SEND ")) {
      int tempToSend = input.substring(5).toInt();
      bool commandFound = false;
      for (int i = 0; i < sizeof(tempCommands)/sizeof(tempCommands[0]); i++) {
        if (tempCommands[i].temp == tempToSend) {
          sendIRCommand(tempCommands[i]);
          Serial.printf("Sent command: Temp %d (%s)\n", tempToSend, tempDescriptions[i]);
          commandFound = true;
          break;
        }
      }
      if (!commandFound) {
        Serial.println("Error: Temperature command not found. Use 'LIST' to see available commands.");
      }
    }
    else if (input == "LIST") {
      Serial.println("Available temperature commands:");
      for (int i = 0; i < sizeof(tempCommands)/sizeof(tempCommands[0]); i++) {
        Serial.printf("Temp %d: %s\n", tempCommands[i].temp, tempDescriptions[i]);
      }
    }
    else if (input == "HELP") {
      Serial.println("Available commands:");
      Serial.println("SET hh:mm temp - Schedule a temperature change");
      Serial.println("TIME - Show current RTC time");
      Serial.println("SEND <temp> - Send IR command for specified temperature");
      Serial.println("LIST - List all available temperature commands");
      Serial.println("HELP - Show this help message");
    }
  }
}

void setup() {
  Serial.begin(115200);
  Wire.begin(DS3231_SDA, DS3231_SCL);

  if (!rtc.begin()) Serial.println("RTC Not Found!");
  if (rtc.lostPower()) rtc.adjust(DateTime(F(__DATE__), F(__TIME__)));

  setupPWM();
  Serial.println("System Ready");
  Serial.println("Type 'HELP' for available commands");
}

void loop() {
  checkSchedules();
  serialTimeSetup();
  delay(1000);
}
